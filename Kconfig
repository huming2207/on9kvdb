## Kconfig
```kconfig
menu "on9kvdb"

    config ON9KVDB_MAX_LIVE_DATA_SIZE
        int "Maximum encoded logical state in bytes"
        default 786432
        range 65536 4294967295
        help
            Maximum encoded size of the newest committed namespace/key
            records, including tombstones. This includes record metadata,
            namespace, key, type, and value bytes. Existing databases must
            match this build-time value exactly.

    config ON9KVDB_PROVISIONED_DATABASE_SIZE
        int "Total provisioned database size in bytes"
        default 6291456
        range 196608 4294967295
        help
            Exact size of the exclusive raw block-device range containing the
            manifest, both WAL slots, every SSTable slot, and both fixed
            value banks. Existing databases must match this build-time value
            exactly.

    config ON9KVDB_WAL_FILE_SIZE
        int "Size of each WAL slot in bytes"
        default 262144
        range 65536 4294967295
        help
            Fixed logical size of each of the two permanent WAL slots.
            Must be a multiple of 4096 bytes.

    config ON9KVDB_SSTABLE_FILE_SIZE
        int "Size of each SSTable slot in bytes"
        default 610304
        range 65536 4294967295
        help
            Fixed logical size of each permanent SSTable slot. The
            default is 596 KiB. Must be a multiple of 4096 bytes.

    config ON9KVDB_SSTABLE_COUNT
        int "Number of permanent SSTable slots"
        default 6
        range 4 16
        help
            Even number of fixed physical SSTable slots split into two equal
            compaction banks inside the exclusive raw device range.

    config ON9KVDB_SSTABLE_BLOCK_SIZE
        int "Logical SSTable block size in bytes"
        default 16384
        range 16384 65536
        help
            Size of each immutable SSTable data/index block. It must be a
            multiple of 4096 bytes, fit 128-byte binary namespace/key
            records, divide the configured SSTable data region exactly, and
            fit two blocks plus sortable memtable offsets in the runtime
            scratch arena.
            Existing databases must match this value exactly.

    config ON9KVDB_VALUE_BANK_SIZE
        int "Size of each append-only value bank in bytes"
        default 1048576
        range 65536 4294967295
        help
            Fixed logical size of each of the two append-only value banks.
            Values larger than ON9KVDB_INLINE_VALUE_SIZE are stored as
            CRC-protected 4096-byte chunks in the active bank. The configured
            logical capacity remains the practical maximum value length.

    config ON9KVDB_INLINE_VALUE_SIZE
        int "Largest inline value in bytes"
        default 1024
        range 1 4096
        help
            Values at or below this size remain in WAL and SSTable records.
            Larger values use the append-only value banks and streaming API.
            Existing databases must match this value exactly.

    config ON9KVDB_MAX_VALUE_READERS
        int "Maximum simultaneous value readers"
        default 2
        range 1 16
        help
            Fixed reader-slot count. Each slot reserves one DMA-capable
            4096-byte buffer at initialization for zero-copy peek/consume.

    config ON9KVDB_RUNTIME_MEMORY_BUDGET
        int "Default component-owned runtime memory budget in bytes"
        default 102400
        range 32768 204799
        help
            Default memory budget used by on9kvdb_cfg. The v1 target is
            PSRAM and all runtime overrides must remain below 200 KiB.
            No component-owned allocation is allowed during normal operations
            after initialization completes.

    config ON9KVDB_REQUIRE_PSRAM
        bool "Require PSRAM for the bulk runtime arena"
        default y
        help
            Allocate the bounded bulk arena explicitly from PSRAM and fail
            initialization with ESP_ERR_NOT_SUPPORTED if PSRAM is unavailable.
            The 4096-byte I/O frame remains in internal DMA-capable RAM.

    config ON9KVDB_MAX_NAMESPACES
        int "Maximum durable namespaces"
        default 64
        range 1 1024
        help
            Maximum number of namespaces recoverable by this build. Existing
            databases must match this value exactly.

    config ON9KVDB_MAX_OPEN_HANDLES
        int "Maximum simultaneously open namespace handles"
        default 8
        range 1 256
        help
            Fixed generation-checked handle-table capacity. Existing databases
            must match this value exactly in v1.

    config ON9KVDB_MEMTABLE_ENTRY_COUNT
        int "Maximum Phase 3 memtable entries"
        default 512
        range 16 4096
        help
            Fixed open-addressed memtable index capacity. This must be a power
            of two. Existing databases must match this value exactly.

    config ON9KVDB_MEMTABLE_DATA_SIZE
        int "Memtable record arena size in bytes"
        default 36864
        range 8192 131072
        help
            Fixed byte capacity for newest committed memtable records and
            tombstones. This is a runtime arena limit, not total live database
            size.

    config ON9KVDB_TRANSACTION_STAGING_SIZE
        int "Maximum staged value bytes per transaction"
        default 24576
        range 8192 131072
        help
            Sum of value bytes staged by the one active transaction. Replacing
            the same key reclaims its previous staged bytes. Existing databases
            must match this value exactly.

    config ON9KVDB_MAX_TRANSACTION_MUTATIONS
        int "Maximum distinct keys per transaction"
        default 10
        range 1 10
        help
            A repeated mutation of the same key counts once. Existing databases
            must match this value exactly.

endmenu
```
